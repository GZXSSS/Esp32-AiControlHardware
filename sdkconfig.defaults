## sdkconfig.defaults
```kconfig
CONFIG_ESPTOOLPY_FLASHSIZE="4MB"
CONFIG_ESPTOOLPY_FLASHSIZE_4MB=y
CONFIG_PARTITION_TABLE_CUSTOM=y
CONFIG_PARTITION_TABLE_CUSTOM_FILENAME="partitions/4m.csv"
CONFIG_PARTITION_TABLE_FILENAME="partitions/4m.csv"
CONFIG_PARTITION_TABLE_OFFSET=0x8000
```

## sdkconfig.defaults.esp32s3
```kconfig
CONFIG_ESPTOOLPY_FLASHSIZE="16MB"
CONFIG_ESPTOOLPY_FLASHSIZE_16MB=y
CONFIG_PARTITION_TABLE_CUSTOM=y
CONFIG_PARTITION_TABLE_CUSTOM_FILENAME="partitions/16m.csv"
CONFIG_PARTITION_TABLE_FILENAME="partitions/16m.csv"
CONFIG_PARTITION_TABLE_OFFSET=0x8000
```
